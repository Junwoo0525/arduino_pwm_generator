// SSD1315 1.3 inch

#include <Arduino.h>
#include <U8g2lib.h>
#include <Encoder.h>

#ifdef U8X8_HAVE_HW_SPI
#include <SPI.h>
#endif
#ifdef U8X8_HAVE_HW_I2C
#include <Wire.h>
#endif

U8G2_SSD1306_128X64_NONAME_F_SW_I2C u8g2(U8G2_R0, /* clock=*/ SCL, /* data=*/ SDA, /* reset=*/ U8X8_PIN_NONE);



#define CLK 2    // 2번핀을 CLK에 연결
#define DT 3     // 3번핀을 DT에 연결

Encoder myEnc(CLK, DT);

int sw = 4;
int mode = 0;


int32_t frequency = 241; //frequency (in Hz)

//PWM
#include <PWM.h>
int pwm = 9;
int pwmdutyper = 0;

//ON&OFF
bool out = false;


//logo
const unsigned char angchicken [] PROGMEM = {
  0xff, 0xff, 0xff, 0xff, 0xff, 0xff, 0xff, 0xff, 0x7f, 0xf0, 0xff, 0xff, 0xff, 0xff, 0xff, 0xff,
  0xff, 0xff, 0xff, 0xff, 0xff, 0xff, 0xff, 0xff, 0x03, 0x80, 0xff, 0xff, 0xff, 0xff, 0xff, 0xff,
  0xff, 0xff, 0xff, 0xff, 0xff, 0xff, 0xff, 0xff, 0x00, 0xc0, 0xff, 0xff, 0xff, 0xff, 0xff, 0xff,
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  0xff, 0xff, 0xff, 0xff, 0xff, 0xff, 0xff, 0xff, 0xff, 0xff, 0xff, 0xff, 0xff, 0xff, 0xff, 0xff


};

long oldPosition  = 0;

void setup() {

  pinMode(sw, INPUT);

  InitTimersSafe();
  bool success = SetPinFrequencySafe(pwm, frequency);
  if (success) {
    pinMode(13, OUTPUT);
    digitalWrite(13, HIGH);
  }


  // 시리얼 출력 개시
  Serial.begin(9600);
  u8g2.begin();


  //OLED
  /*u8g2.setFont(u8g_font_unifont);
    u8g2.setFont(u8g2_font_6x10_tf);
    u8g2.setColorIndex(1);
  */
  u8g2_prepare();
  u8g2.setFont(u8g2_font_t0_12b_mf);
  u8g2.setColorIndex(1);

  //
  logoRun();
  delay(3000);
  u8g2.clearBuffer();
  delay(500);
  oledRun();
}

void loop() {
  if (digitalRead(sw) == LOW) {
    if (out == false) {
      setduty(pwmdutyper);
      out = true;
      oledRun();
      Serial.print("ON & duty : ");
      Serial.println(pwmdutyper);

    }
    else {
      setduty(0);
      out = false;
      oledRun();
      Serial.println("OFF");
    }
    while (1) {
      if (digitalRead(sw) == HIGH)
        break;
    }
  }

  readEncoder();

}

//OLED 기본 세팅

void u8g2_prepare(void) {
  u8g2.setFont(u8g2_font_7x14_tf);
  u8g2.setFontRefHeightExtendedText();
  u8g2.setDrawColor(1);
  u8g2.setFontPosTop();
  u8g2.setFontDirection(0);
}

int setduty(int dutyper) {
  int duty = map(dutyper, 0, 100, 0, 255);
  pwmWrite(pwm, duty);
}

void readEncoder() {
  long newPosition = myEnc.read();
  long newPositionDiv4 = newPosition / 4;
  if ((newPosition % 4 == 0) and (newPositionDiv4 != oldPosition)) {
    if (oldPosition > newPositionDiv4) {
      if (out == false) {
        if (mode >= 4) mode = 0;
        else mode++;
        Serial.println(mode);
        pwmMode();
        oledRun();
      }
    }
    else if (oldPosition < newPositionDiv4) {
      if (out == false) {
        if (mode == 0) mode = 4;
        else mode--;
        Serial.println(mode);
        pwmMode();
        oledRun();
      }
    }
    else {
      Serial.println("error");
    }
    oldPosition = newPositionDiv4;

  }
}



//OLED문자 출력 함수

void oledRun() {
  u8g2.firstPage();
  do {
    draw();
  } while ( u8g2.nextPage() );
  delay(10);
}

void pwmMode() {
  switch (mode) {
    case 0:
      pwmdutyper = 0;
      break;
    case 1:
      pwmdutyper = 25;
      break;
    case 2:
      pwmdutyper = 50;
      break;
    case 3:
      pwmdutyper = 75;
      break;
    case 4:
      pwmdutyper = 100;
      break;
  }
}

void draw()
{
  //Frequencyh
  u8g2.drawStr( 0, 5, "Hz :");
  u8g2.setCursor(60, 5);
  u8g2.print(frequency - 1);
  //u8g2.sendBuffer();

  //DUTY
  u8g2.drawStr(0, 27, "Duty :");
  u8g2.setCursor(60, 25);
  u8g2.print(pwmdutyper);
  //u8g2.sendBuffer();
  //ON/OFF
  u8g2.drawStr(0, 49, "OUTPUT : ");
  if (out == 0) {
    u8g2.drawStr(60, 49, "OFF");
    //u8g2.sendBuffer();

  }
  else if (out == 1) {
    u8g2.drawStr(60, 50, "ON");
    //u8g2.sendBuffer();

  }
}


//LOGO RUN
void logoRun() {
  u8g2.firstPage();
  do {
    u8g2.drawXBMP(0, 0, 128, 64, angchicken);
  } while ( u8g2.nextPage() );
}
